## code/lidar_board/src/Kconfig.projbuild
```kconfig
menu "ESCROCS Configuration"
config ESP_WIFI_SSID
    string "SSID of the Wifi AP"
    default "escrobot2"

config ESP_WIFI_PASSWORD
    string "WiFi Password"
    default "password"

config ESP_WIFI_SUBNET
    int "IP subnet (3rd byte)"
    default 4

config LIDAR_CALIBRATION
    int "Lidar angle calibration (x1000)"
    default 0
endmenu
```

## code/main_board/src/Kconfig.projbuild
```kconfig
menu "ESCROCS Configuration"
    config ESP_WIFI_SSID
        string "WiFi SSID"
        default "escrobot"

    config ESP_WIFI_CHANNEL
        int "WiFi Channel"
        range 1 13
        default 1

    config ESP_WIFI_PASSWORD
        string "WiFi Password"
        default "password"
    
    config ESP_WIFI_SUBNET
        int "IP subnet (3rd byte)"
        default 4
endmenu
```

## robot2/code/main_board/src/Kconfig.projbuild
```kconfig
menu "ESCROCS Configuration"
config ESP_WIFI_SSID
    string "WiFi SSID"
    default "escrobot"

config ESP_WIFI_CHANNEL
    int "WiFi Channel"
    range 1 13
    default 1

config ESP_WIFI_PASSWORD
    string "WiFi Password"
    default "password"
endmenu
```
